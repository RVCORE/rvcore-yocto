## meta-rvcore/conf/distro/rvcore-distro.conf
```bitbake
DISTRO = "rvcore-distro"
DISTRO_NAME = "rvcore linux distribution"

DISTRO_VERSION = "1.1"

DISTRO_FEATURES ?= "${DISTRO_FEATURES_DEFAULT} security virtualization vulkan"
```

## meta-rvcore/conf/layer.conf
```bitbake
BBPATH .= ":${LAYERDIR}"
BBFILES += "${LAYERDIR}/recipes-*/*/*.bb \
           ${LAYERDIR}/recipes-*/*/*.bbappend"


BBFILE_COLLECTIONS += "rvcore"
BBFILE_PATTERN_rvcore = "^${LAYERDIR}/"
BBFILE_PRIORITY_rvcore = "9"
LAYERDEPENDS_rvcore = "core"

LAYERSERIES_COMPAT_rvcore = "mickledore kirkstone langdale"
```

## meta-rvcore/conf/machine/yinxing-fpga.conf
```bitbake
#@TYPE: Machine
#@NAME: yinxing riscv64 machine
#@DESCRIPTION: Machine configuration for running a yinxing riscv64

DEFAULTTUNE = "riscv64"
#require conf/machine/include/qemu.inc
require conf/machine/include/riscv/tune-riscv.inc

MACHINEOVERRIDES =. "yinxing-fpga:"

MACHINE_FEATURES = "ext2 ext3 serial"

IMAGE_FSTYPES += "tar.bz2 ext4"

PREFERRED_PROVIDER_virtual/kernel = "linux-yocto"
PREFERRED_VERSION_linux-yocto = "5.19%"

EXTRA_IMAGEDEPENDS += "qemu-system-native qemu-helper-native:do_addto_recipe_sysroot"

KERNEL_IMAGETYPE = "Image"
KERNEL_IMAGETYPES += "vmlinux"

#PREFERRED_VERSION_openocd-native = "riscv"
#PREFERRED_VERSION_openocd = "riscv"

RISCV_SBI_PLAT ?= "generic"
RISCV_SBI_PAYLOAD ?= "${KERNEL_IMAGETYPE}-${MACHINE}.bin"

#SERIAL_CONSOLES ?= "115200;ttyS0 115200;hvc0"
SERIAL_CONSOLES ?= "115200;hvc0"
SERIAL_CONSOLES_CHECK = "${SERIAL_CONSOLES}"

IMAGE_FSTYPES += "ext3 tar.gz"

# qemuboot options
QB_SMP = "-smp 4"
QB_KERNEL_CMDLINE_APPEND = "earlycon=sbi"
QB_MACHINE = "-machine virt"

#yingxing fpga use initramfs
INITRAMFS_IMAGE_BUNDLE = "1"
INITRAMFS_IMAGE = "core-image-minimal-initramfs"

VIRTUAL-RUNTIME_dev_manager = "busybox-mdev"
VIRTUAL-RUNTIME_init_manager = "busybox"
```
